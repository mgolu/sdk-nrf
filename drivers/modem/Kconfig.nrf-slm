## drivers/modem/Kconfig.nrf-slm
```kconfig
# Copyright (c) 2023 Nordic Semiconductor
# SPDX-License-Identifier: Apache-2.0

config MODEM_NRF_SLM
	bool "Host driver for nRF9x running SLM"
	select MODEM_CONTEXT
	select MODEM_CMD_HANDLER
	select MODEM_IFACE_UART
	select MODEM_SOCKET
	select NET_OFFLOAD
	select NET_SOCKETS_OFFLOAD
	help
	  Choose this setting to enable using Nordic's nRF9x device as
	  a modem when it runs Serial LTE Modem firmware.

if MODEM_NRF_SLM

config MODEM_NRF_SLM_RX_STACK_SIZE
	int "Stack size for the nRF9 SLM modem driver RX thread"
	default 1028
	help
	  This stack is used by the nRF9 SLM RX thread.

config MODEM_NRF_SLM_RX_WORKQ_STACK_SIZE
	int "Stack size for the nRF9 SLM modem driver work queue"
	default 2048
	help
	  This stack is used by the work queue to pass off net_pkt data
	  to the rest of the network stack, letting the rx thread continue
	  processing data.

config MODEM_NRF_SLM_INIT_PRIORITY
	int "nRF9 SLM driver init priority"
	default 80
	help
	  nRF9 SLM device driver initialization priority.
	  Do not mess with it unless you know what you are doing.
	  Note that the priority needs to be lower than the net stack
	  so that it can start before the networking sub-system.

config SLM_DATAMODE_TERMINATOR
	string "Pattern string to terminate data mode"
	default "+++"
	help
	  Use a pattern to terminate data mode


endif
```

## dts/bindings/net/nordic,nrf_slm.yaml
```yaml
# Copyright (c) 2023 Nordic Semiconductor ASA
# SPDX-License-Identifier: Apache-2.0

description: nordic nRF9 SLM modem

compatible: "nordic,nrf_slm"

include: uart-device.yaml

on-bus: uart
```
